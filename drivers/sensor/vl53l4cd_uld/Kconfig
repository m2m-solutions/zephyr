## drivers/sensor/vl53l4cd_uld/Kconfig
```kconfig
menuconfig VL53L4CD
    bool "ST VL53L4CD Time-of-Flight sensor"
    depends on I2C && GPIO 
    help
        Enable driver for the ST VL53L4CD ToF sensor.


if VL53L4CD
    config VL53L4CD_DEFAULT_TIMING_BUDGET_MS
        int "Default timing budget (ms)"
        range 10 200
        default 50
        help
            Used if devicetree property timing-budget-ms is absent.
endif # VL53L4CD
```

## dts/bindings/sensor/st,vl53l4cd.yaml
```yaml
# SPDX-License-Identifier: Apache-2.0

description: >
  STMicroelectronics VL53L4CD ULD ToF sensor

compatible: "st,vl53l4cd"

include: i2c-device.yaml

properties:
  timing-budget-ms:
    type: int
    required: false
    description: Ranging timing budget in milliseconds (e.g. 50)
  inter-measure-ms:
    type: int
    required: false
    description: Inter-measurement period in milliseconds (0 for back-to-back)
  xshut-gpios:
    type: phandle-array
    required: false
```
