## drivers/display/Kconfig.st7565
```kconfig
# ST7565 display driver configuration options

# Copyright (c) 2022 Mark Olsson <mark@markolsson.se>
# SPDX-License-Identifier: Apache-2.0

menuconfig ST7565
	bool "ST7565 display driver"
	depends on SPI
	help
	  Enable driver for ST7565 display driver.

if LVGL

choice LV_COLOR_DEPTH
	default LV_COLOR_DEPTH_1
endchoice

endif # LVGL
```

## drivers/spi/Kconfig.rpi_pico
```kconfig
# Copyright (c) 2022 Pete Johanson
# SPDX-License-Identifier: Apache-2.0

# Workaround for not being able to have commas in macro arguments
DT_COMPAT_RPI_PICO_SPI := raspberrypi,pico-spi

config SPI_RPI_PICO
	default $(dt_compat_enabled,$(DT_COMPAT_RPI_PICO_SPI))
	select PICOSDK_USE_SPI
	bool "RaspberryPi Pico SPI driver"
```

## dts/bindings/display/sitronix,st7565.yaml
```yaml
# Copyright (c) 2022, Mark Olsson <mark@markolsson.se>
# SPDX-License-Identifier: Apache-2.0

description: ST7565 display controller

compatible: "sitronix,st7565"

include: [spi-device.yaml, display-controller.yaml]

properties:
    reset-gpios:
      type: phandle-array
      required: true
      description: RESET pin.

        The RESET pin of ST7565 is active low.
        If connected directly the MCU pin should be configured
        as active low.

    cmd-data-gpios:
      type: phandle-array
      required: true
      description: D/CX pin.

        The D/CX pin of ST7565 is active low (transmission command byte).
        If connected directly the MCU pin should be configured
        as active low.
```
